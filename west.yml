## west.yml
```yaml
manifest:
  self:
    west-commands: scripts/west-commands.yml

  remotes:
    - name: nordic
      url-base: https://github.com/nrfconnect

  projects:
    - name: sdk-nrf
      remote: nordic
      revision: v3.0.2        # or a tag/sha you trust
      path: nrf
      import:                 # pull the extra modules nrf’s sub-manifest needs
        name-allowlist:
          - cmsis             # required by the ARM port
          - hal_nordic        # already present, but import keeps versions aligned
          - mcuboot           # Nordic keeps its mcuboot fork here
          - nrfxlib           # soft-device controller, ZBOSS, …
          - segger            # RTT, systemview etc.  (optional)
          - zephyr            # The zephyr RTOS
```
